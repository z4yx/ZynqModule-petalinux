/*
 * CAUTION: This file is automatically generated by Xilinx.
 * Version: HSI 2016.3
 * Today is: Sun Oct 22 23:49:29 2017
*/


/ {
	amba_pl: amba_pl {
		#address-cells = <1>;
		#size-cells = <1>;
		compatible = "simple-bus";
		ranges ;
		debug_bridge_0: debug_bridge@43c00000 {
			compatible = "xlnx,debug-bridge-3.0";
			reg = <0x43c00000 0x10000>;
			xlnx,bscan-mux = <0x1>;
			xlnx,build-revision = <0x0>;
			xlnx,chip-id = <0x0>;
			xlnx,clk-input-freq-hz = <0x11e1a300>;
			xlnx,core-major-ver = <0x1>;
			xlnx,core-minor-alpha-ver = <0x61>;
			xlnx,core-minor-ver = <0x0>;
			xlnx,core-type = <0x1>;
			xlnx,dclk-has-reset = <0x0>;
			xlnx,debug-mode = <0x2>;
			xlnx,design-type = <0x0>;
			xlnx,device-family = <0x0>;
			xlnx,en-bscanid-vec = "false";
			xlnx,en-int-sim = <0x1>;
			xlnx,en-passthrough = <0x0>;
			xlnx,enable-clk-divider = "false";
			xlnx,fifo-style = "SUBCORE";
			xlnx,ir-id-instr = <0x0>;
			xlnx,ir-user1-instr = <0x0>;
			xlnx,ir-width = <0x0>;
			xlnx,major-version = <0xe>;
			xlnx,master-intf-type = <0x1>;
			xlnx,minor-version = <0x1>;
			xlnx,num-bs-master = <0x0>;
			xlnx,pcie-ext-cfg-base-addr = <0x400>;
			xlnx,pcie-ext-cfg-next-ptr = <0x000>;
			xlnx,pcie-ext-cfg-vsec-id = <0x0008>;
			xlnx,pcie-ext-cfg-vsec-length = <0x020>;
			xlnx,pcie-ext-cfg-vsec-rev-id = <0x0>;
			xlnx,tck-clock-ratio = <0x8>;
			xlnx,two-prim-mode = "false";
			xlnx,use-bufr = <0x0>;
			xlnx,use-ext-bscan = "true";
			xlnx,use-softbscan = <0x1>;
			xlnx,use-startup-clk = "false";
			xlnx,user-scan-chain = <0x1>;
			xlnx,xsdb-num-slaves = <0x0>;
			xlnx,xvc-hw-id = <0x0001>;
			xlnx,xvc-sw-id = <0x0001>;
		};
	};
};
